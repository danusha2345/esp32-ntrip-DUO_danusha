## main/Kconfig.projbuild
```kconfig
menu "SD logger configuration"

    config SD_LOGGER_MISO_GPIO
        int "SD card MISO GPIO"
        range 0 48
        default 7 if IDF_TARGET_ESP32C3
        default 2

    config SD_LOGGER_MOSI_GPIO
        int "SD card MOSI GPIO"
        range 0 48
        default 15

    config SD_LOGGER_CLK_GPIO
        int "SD card clock GPIO"
        range 0 48
        default 14

    config SD_LOGGER_CS_GPIO
        int "SD card chip-select GPIO"
        range 0 48
        default 13

endmenu
```
